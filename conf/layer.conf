## conf/layer.conf
```bitbake
# We have a conf and classes directory, add to BBPATH
BBPATH .= ":${LAYERDIR}"

# We have a packages directory, add to BBFILES
BBFILES += "${LAYERDIR}/recipes-*/*/*.bb \
            ${LAYERDIR}/recipes-*/*/*.bbappend"

BBFILE_COLLECTIONS += "coral-ai"
BBFILE_PATTERN_coral-ai := "^${LAYERDIR}/"
BBFILE_PRIORITY_coral-ai = "6"
LAYERSERIES_COMPAT_coral-ai = "scarthgap"
LAYERDEPENDS_coral-ai = "core freescale-layer openembedded-layer meta-tensorflow"
```

## conf/machine/imx8mq-phanbell.conf
```bitbake
#@TYPE: Machine
#@NAME: Google i.MX8MQ Phanbell
#@SOC: i.MX8MQ
#@DESCRIPTION: Machine configuration for Google i.MX8MQ Phanbell Coral Dev Board
#@MAINTAINER: Ayoub Zaki <ayoub.zaki@embetrix.com>

MACHINEOVERRIDES =. "mx8mq:use-mainline-bsp:"

require conf/machine/include/imx-base.inc
require conf/machine/include/arm/armv8a/tune-cortexa53.inc

# Mainline BSP defaults to "generic" cortexa53 configuration,
# adjust it here to include crypto extension which enables
# inline NEON and FPU code generation
DEFAULTTUNE:use-mainline-bsp = "cortexa53-crypto"

MACHINE_FEATURES += "pci wifi bluetooth bcm43455 bcm4356 nxp8997-pcie nxp8997-sdio nxp9098-pcie nxp9098-sdio"
MACHINE_FEATURES:append:use-nxp-bsp = " optee bcm4359"

MACHINE_SOCARCH_FILTER:append:mx8mq = " virtual/libopenvg virtual/libgles1 virtual/libgles2 virtual/egl virtual/mesa virtual/libgl virtual/libg2d"

KERNEL_DEVICETREE = " \
	freescale/imx8mq-phanbell.dtb \
"

IMX_DEFAULT_BOOTLOADER:use-nxp-bsp = "u-boot-imx"
IMX_DEFAULT_BOOTLOADER:use-mainline-bsp = "u-boot-fslc"

UBOOT_SUFFIX = "bin"

UBOOT_CONFIG ??= "sd"
UBOOT_CONFIG[sd]       = "imx8mq_phanbell_defconfig,sdcard"

SPL_BINARY = "spl/u-boot-spl.bin"

# Set DDR FIRMWARE
DDR_FIRMWARE_NAME = " \
    lpddr4_pmu_train_1d_imem.bin \
    lpddr4_pmu_train_1d_dmem.bin \
    lpddr4_pmu_train_2d_imem.bin \
    lpddr4_pmu_train_2d_dmem.bin \
"

# Set u-boot DTB
UBOOT_DTB_NAME = "imx8mq-phanbell.dtb"

# Set ATF platform name
ATF_PLATFORM = "imx8mq"

# Set imx-mkimage boot target
IMXBOOT_TARGETS = "flash_evk flash_evk_no_hdmi flash_dp_evk"
IMX_BOOT_SOC_TARGET = "iMX8M"

LOADADDR = ""
UBOOT_MAKE_TARGET = ""
IMX_BOOT_SEEK = "33"

OPTEE_BIN_EXT = "8mq"

# Add additional firmware
MACHINE_FIRMWARE:append = " linux-firmware-ath10k"

UBOOT_PROVIDES_BOOT_CONTAINER = "0"

WKS_FILE_DEPENDS += "imx-boot"

MACHINE_EXTRA_RDEPENDS += "kernel-modules \
                           gasket-driver \
                           ${@bb.utils.contains('MACHINE_FEATURES', 'optee', 'optee-test optee-client', '', d)} \
                           "
```
